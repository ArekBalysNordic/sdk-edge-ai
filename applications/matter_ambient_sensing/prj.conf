## CMakeLists.txt
```
#
# Copyright (c) 2026 Nordic Semiconductor ASA
#
# SPDX-License-Identifier: LicenseRef-Nordic-5-Clause
#

cmake_minimum_required(VERSION 3.20.0)

find_package(Zephyr REQUIRED HINTS $ENV{ZEPHYR_BASE})
project(matter_ambient_sensing)

# Enable GNU STD support.
include(${ZEPHYR_CONNECTEDHOMEIP_MODULE_DIR}/config/nrfconnect/app/enable-gnu-std.cmake)

# NORDIC SDK APP START

# Include all source files that are located in the Matter common directory.
include(${ZEPHYR_NRF_MODULE_DIR}/samples/matter/common/cmake/source_common.cmake)

# Include Data Model utils
include(${ZEPHYR_NRF_MODULE_DIR}/samples/matter/common/cmake/data_model.cmake)

include(${ZEPHYR_NRF_MODULE_DIR}/samples/matter/common/cmake/zap_helpers.cmake)
ncs_get_zap_parent_dir(ZAP_PARENT_DIR)

set(MATTER_EDGEAI_COMMON_DIR ${CMAKE_CURRENT_SOURCE_DIR}/../matter_common)

target_include_directories(app PRIVATE
  src
  src/edgeAI
  ${MATTER_EDGEAI_COMMON_DIR}
  ${ZAP_PARENT_DIR}
)

target_compile_options(app PRIVATE -Wno-deprecated-declarations)

target_sources(app PRIVATE
  src/main.cpp
  src/app_task.cpp
  src/nrf_edgeai_task.cpp

  src/ambient_sensing.cpp

  ${MATTER_EDGEAI_COMMON_DIR}/dmic.c
  ${MATTER_EDGEAI_COMMON_DIR}/dimming_effect.cpp
)

target_sources_ifdef(CONFIG_AMBIENT_SENSING_MODEL_SNORING app PRIVATE src/models/snoring/nrf_edgeai_user_model.c)
target_sources_ifdef(CONFIG_AMBIENT_SENSING_MODEL_DOG_BARKING app PRIVATE src/models/dog_barking/nrf_edgeai_user_model.c)
target_sources_ifdef(CONFIG_AMBIENT_SENSING_MODEL_CAT_MEOWING app PRIVATE src/models/cat_meowing/nrf_edgeai_user_model.c)
target_sources_ifdef(CONFIG_AMBIENT_SENSING_MODEL_BABY_CRYING app PRIVATE src/models/baby_crying/nrf_edgeai_user_model.c)

# Multi-threaded mode: compile every built-in model at once.
if(CONFIG_AMBIENT_SENSING_MODEL_ALL)
  target_sources(app PRIVATE
    src/models/snoring/nrf_edgeai_user_model.c
    src/models/dog_barking/nrf_edgeai_user_model.c
    src/models/cat_meowing/nrf_edgeai_user_model.c
    src/models/baby_crying/nrf_edgeai_user_model.c
  )
endif()

ncs_configure_data_model()
```

## Kconfig
```
#
# Copyright (c) 2026 Nordic Semiconductor ASA
#
# SPDX-License-Identifier: LicenseRef-Nordic-5-Clause
#

rsource "../matter_common/Kconfig.edgeai"

menu "Matter Edge AI Switch"

choice AMBIENT_SENSING_MODEL
	prompt "Matter Ambient Sensing model"
	default AMBIENT_SENSING_MODEL_SNORING
	help
	  Choose the type of ambient sensing source to use.

config AMBIENT_SENSING_MODEL_SNORING
	bool "Snoring"
	help
	  Use the Snoring model for ambient sensing.

config AMBIENT_SENSING_MODEL_BABY_CRYING
	bool "Crying"
	help
	  Use the Baby Crying model for ambient sensing.

config AMBIENT_SENSING_MODEL_DOG_BARKING
	bool "Barking"
	help
	  Use the Barking model for ambient sensing.

config AMBIENT_SENSING_MODEL_CAT_MEOWING
	bool "Cat Meowing"
	help
	  Use the Meowing model for ambient sensing.

config AMBIENT_SENSING_MODEL_CUSTOM
	bool "Custom model"
	help
	  Use a custom model for ambient sensing.

endchoice

config AMBIENT_SENSING_MODEL_CUSTOM_PATH
	string "Path to the custom model"
	default ""
	help
	  Path to the custom model,

config AMBIENT_SENSING_ENDPOINT_ID
	int "Ambient Sensing Endpoint ID"
	default 1
	help
	  Endpoint ID for the ambient sensing.

config AI_THREAD_STACK_SIZE
	int "Edge AI thread stack size"
	default 6144
	help
	  Stack size for AI thread.

config AI_THREAD_PRIORITY
	int "Edge AI thread priority"
	default 8
	help
	  Preemptible thread priority.

endmenu

config USE_OCCUPANCY_SENSOR_INSTEAD_OF_AMBIENT_SENSING
	bool "Use occupancy sensor instead of ambient sensing"
	help
	  Use occupancy sensor instead of ambient sensing for testing purposes.

config NCS_SAMPLE_MATTER_ZAP_FILE_PATH
	default "${APPLICATION_CONFIG_DIR}/src/occupancy_sensor_zap/occupancy_sensor.zap" if USE_OCCUPANCY_SENSOR_INSTEAD_OF_AMBIENT_SENSING
	default "${APPLICATION_CONFIG_DIR}/src/ambient_sensing_zap/ambient_sensing.zap"

# Sample configuration used for Thread networking
if OPENTHREAD

choice OPENTHREAD_NORDIC_LIBRARY_CONFIGURATION
	default OPENTHREAD_NORDIC_LIBRARY_FTD
endchoice

choice OPENTHREAD_DEVICE_TYPE
	default OPENTHREAD_FTD
endchoice

endif # OPENTHREAD

source "$(ZEPHYR_CONNECTEDHOMEIP_MODULE_DIR)/config/nrfconnect/chip-module/Kconfig.features"
source "$(ZEPHYR_CONNECTEDHOMEIP_MODULE_DIR)/config/nrfconnect/chip-module/Kconfig.defaults"
source "$(ZEPHYR_NRF_MODULE_DIR)/samples/matter/common/src/Kconfig"
source "Kconfig.zephyr"
```

## sample.yaml
```
sample:
  description: Matter Switch application
  name: Matter Switch

common:
  sysbuild: true
  build_only: true
  tags:
    - ci_build
    - sysbuild

tests:
  applications.matter_ambient_sensing.snoring_dmic_adafruit:
    extra_args:
      - CONFIG_AMBIENT_SENSING_MODEL_SNORING=y
      - EXTRA_DTC_OVERLAY_FILE=boards/dmic_adafruit.dtsi
    platform_allow:
      - nrf54lm20dk/nrf54lm20b/cpuapp
    integration_platforms:
      - nrf54lm20dk/nrf54lm20b/cpuapp
  applications.matter_ambient_sensing.snoring_dmic_low_power:
    extra_args:
      - CONFIG_AMBIENT_SENSING_MODEL_SNORING=y
      - EXTRA_DTC_OVERLAY_FILE=boards/dmic_low_power.dtsi
    platform_allow:
      - nrf54lm20dk/nrf54lm20b/cpuapp
    integration_platforms:
      - nrf54lm20dk/nrf54lm20b/cpuapp
  applications.matter_ambient_sensing.baby_crying_dmic_adafruit:
    extra_args:
      - CONFIG_AMBIENT_SENSING_MODEL_BABY_CRYING=y
      - EXTRA_DTC_OVERLAY_FILE=boards/dmic_adafruit.dtsi
    platform_allow:
      - nrf54lm20dk/nrf54lm20b/cpuapp
    integration_platforms:
      - nrf54lm20dk/nrf54lm20b/cpuapp
  applications.matter_ambient_sensing.baby_crying_dmic_low_power:
    extra_args:
      - CONFIG_AMBIENT_SENSING_MODEL_BABY_CRYING=y
      - EXTRA_DTC_OVERLAY_FILE=boards/dmic_low_power.dtsi
    platform_allow:
      - nrf54lm20dk/nrf54lm20b/cpuapp
    integration_platforms:
      - nrf54lm20dk/nrf54lm20b/cpuapp
  applications.matter_ambient_sensing.dog_barking_dmic_adafruit:
    extra_args:
      - CONFIG_AMBIENT_SENSING_MODEL_DOG_BARKING=y
      - EXTRA_DTC_OVERLAY_FILE=boards/dmic_adafruit.dtsi
    platform_allow:
      - nrf54lm20dk/nrf54lm20b/cpuapp
    integration_platforms:
      - nrf54lm20dk/nrf54lm20b/cpuapp
  applications.matter_ambient_sensing.dog_barking_dmic_low_power:
    extra_args:
      - CONFIG_AMBIENT_SENSING_MODEL_DOG_BARKING=y
      - EXTRA_DTC_OVERLAY_FILE=boards/dmic_low_power.dtsi
    platform_allow:
      - nrf54lm20dk/nrf54lm20b/cpuapp
    integration_platforms:
      - nrf54lm20dk/nrf54lm20b/cpuapp
  applications.matter_ambient_sensing.cat_meowing_dmic_adafruit:
    extra_args:
      - CONFIG_AMBIENT_SENSING_MODEL_CAT_MEOWING=y
      - EXTRA_DTC_OVERLAY_FILE=boards/dmic_adafruit.dtsi
    platform_allow:
      - nrf54lm20dk/nrf54lm20b/cpuapp
    integration_platforms:
      - nrf54lm20dk/nrf54lm20b/cpuapp
  applications.matter_ambient_sensing.cat_meowing_dmic_low_power:
    extra_args:
      - CONFIG_AMBIENT_SENSING_MODEL_CAT_MEOWING=y
      - EXTRA_DTC_OVERLAY_FILE=boards/dmic_low_power.dtsi
    platform_allow:
      - nrf54lm20dk/nrf54lm20b/cpuapp
    integration_platforms:
      - nrf54lm20dk/nrf54lm20b/cpuapp
  applications.matter_ambient_sensing.all_models_dmic_adafruit:
    extra_args:
      - CONFIG_AMBIENT_SENSING_MODEL_ALL=y
      - EXTRA_DTC_OVERLAY_FILE=boards/dmic_adafruit.dtsi
    platform_allow:
      - nrf54lm20dk/nrf54lm20b/cpuapp
    integration_platforms:
      - nrf54lm20dk/nrf54lm20b/cpuapp
  applications.matter_ambient_sensing.all_models_dmic_low_power:
    extra_args:
      - CONFIG_AMBIENT_SENSING_MODEL_ALL=y
      - EXTRA_DTC_OVERLAY_FILE=boards/dmic_low_power.dtsi
    platform_allow:
      - nrf54lm20dk/nrf54lm20b/cpuapp
    integration_platforms:
      - nrf54lm20dk/nrf54lm20b/cpuapp
```

## prj.conf
```kconfig
#
# Copyright (c) 2026 Nordic Semiconductor
#
# SPDX-License-Identifier: LicenseRef-Nordic-5-Clause
#

# Enable CHIP
CONFIG_CHIP=y
CONFIG_CHIP_PROJECT_CONFIG="src/chip_project_config.h"
CONFIG_CHIP_DEVICE_PRODUCT_NAME="Matter Ambient Sensing"

# 32768 == 0x8000 (example Product ID added temporaly,
# but it must be changed with proper PID from the list:
# https://github.com/project-chip/connectedhomeip/blob/482e6fd03196a6de45465a90003947ef4b86e0b1/docs/examples/discussion/PID_allocation_for_example_apps.md)
CONFIG_CHIP_DEVICE_PRODUCT_ID=32768
CONFIG_STD_CPP17=y

# Enable Matter extended announcement and increase duration to 1 hour.
CONFIG_CHIP_BLE_EXT_ADVERTISING=y
CONFIG_CHIP_BLE_ADVERTISING_DURATION=60

# Add support for LEDs and buttons on Nordic development kits
CONFIG_DK_LIBRARY=y

# Bluetooth Low Energy configuration
CONFIG_BT_DEVICE_NAME="MatterAmbient"

# Enable Matter pairing automatically on application start.
CONFIG_CHIP_ENABLE_PAIRING_AUTOSTART=y

# Suspend devices when the CPU goes into sleep
CONFIG_PM_DEVICE=y

# Other settings
CONFIG_THREAD_NAME=y
CONFIG_MPU_STACK_GUARD=y

# Memory: k_malloc pool + Matter chip heap are static (.bss) and sit before the Newlib arena
# (RAM from _end to top of SRAM). Edge AI uses malloc(); if that arena is too small, the first
# stdio/C++ lock init hits: "recursive lock allocation failed" in libc-hooks.c.
CONFIG_MAIN_STACK_SIZE=10240
CONFIG_COMMON_LIBC_MALLOC_ARENA_SIZE=-1
CONFIG_NEWLIB_LIBC_MIN_REQUIRED_HEAP_SIZE=40960
CONFIG_HEAP_MEM_POOL_SIZE=24576
CONFIG_CHIP_MALLOC_SYS_HEAP_SIZE=40960
CONFIG_CHIP_SYSTEM_PACKETBUFFER_POOL_SIZE=24
CONFIG_CHIP_TASK_STACK_SIZE=12288
CONFIG_AI_THREAD_STACK_SIZE=8192
CONFIG_AI_THREAD_PRIORITY=0

# When CONFIG_AMBIENT_SENSING_MODEL_ALL is enabled, the single AI thread
# runs every model back to back on each 10 ms DMIC block. Four inferences
# per frame use noticeably more CPU than a single model, so bump the DMIC
# capture ring to smooth out short scheduling bursts (for example Matter
# stack activity). 24 * 10 ms = 240 ms of headroom before samples are lost.
CONFIG_MATTER_EDGEAI_DMIC_MEM_SLAB_NUM_BLOCKS=24

CONFIG_RESET_ON_FATAL_ERROR=n
CONFIG_CHIP_LIB_SHELL=y
CONFIG_NCS_SAMPLE_MATTER_TEST_SHELL=y

# Reduce application size
CONFIG_USE_SEGGER_RTT=n
CONFIG_MATTER_LOG_LEVEL_INF=y
CONFIG_CHIP_APP_LOG_LEVEL=3

# Enable Factory Data feature
CONFIG_CHIP_FACTORY_DATA=y
CONFIG_CHIP_FACTORY_DATA_BUILD=y

# nRF Edge AI
CONFIG_NRF_EDGEAI=y

# nRF Edge AI dependencies
CONFIG_NRF_AXON=y
CONFIG_NEWLIB_LIBC=y
CONFIG_FPU=y

# Size of interlayer buffer to fit model
CONFIG_NRF_AXON_INTERLAYER_BUFFER_SIZE=6048

# Size of psum buffer to fit model
CONFIG_NRF_AXON_PSUM_BUFFER_SIZE=0

# Enable sensor, button and LED libraries
CONFIG_GPIO=y
CONFIG_AUDIO=y
CONFIG_AUDIO_DMIC=y

# PWM-driven LED dimming on wakeword
CONFIG_PWM=y
```

## src/ambient_sensing.cpp
```c
/*
 * Copyright (c) 2026 Nordic Semiconductor ASA
 *
 * SPDX-License-Identifier: LicenseRef-Nordic-5-Clause
 */

#include "ambient_sensing.h"

#include <zephyr/kernel.h>
#include <zephyr/logging/log.h>
#include <zephyr/sys/__assert.h>
#include <zephyr/sys/util.h>

#include <nrf_edgeai/nrf_edgeai.h>

#include "models/all_models.h"

LOG_MODULE_REGISTER(ambient_sensing, LOG_LEVEL_INF);

namespace
{
/** Default history window bit-width used by every built-in model. */
constexpr uint32_t kDefaultMaxPredictionInRow = 31;

#if defined(CONFIG_AMBIENT_SENSING_MODEL_SNORING)
constexpr float kLegacyConfidenceThreshold = 0.9f;
constexpr uint32_t kLegacyPredictionNumInRow = 20;
const char *kLegacyModelName = "Snoring";
#elif defined(CONFIG_AMBIENT_SENSING_MODEL_BABY_CRYING)
constexpr float kLegacyConfidenceThreshold = 0.996078f;
constexpr uint32_t kLegacyPredictionNumInRow = 3;
const char *kLegacyModelName = "Baby Crying";
#elif defined(CONFIG_AMBIENT_SENSING_MODEL_DOG_BARKING)
constexpr float kLegacyConfidenceThreshold = 0.9f;
constexpr uint32_t kLegacyPredictionNumInRow = 10;
const char *kLegacyModelName = "Dog Barking";
#elif defined(CONFIG_AMBIENT_SENSING_MODEL_CAT_MEOWING)
constexpr float kLegacyConfidenceThreshold = 0.95f;
constexpr uint32_t kLegacyPredictionNumInRow = 9;
const char *kLegacyModelName = "Cat Meowing";
#else
constexpr float kLegacyConfidenceThreshold = 0.9f;
constexpr uint32_t kLegacyPredictionNumInRow = 10;
const char *kLegacyModelName = "Ambient";
#endif

/**
 * @brief Core rolling-window detector shared by single- and multi-threaded
 *        entry points.
 *
 * @note Uses references to caller-owned state so the same logic is safe
 *       to run from multiple threads, one detector instance per thread.
 */
bool rolling_detector_step(nrf_edgeai_t *p_model, float confidence_threshold,
			   uint32_t prediction_num_in_row, uint32_t max_prediction_num_in_row,
			   uint32_t &prediction_count, uint32_t &predictions_history)
{
	/* Read confidence for the model's predicted class for this frame. */
	const uint16_t predicted_class = p_model->decoded_output.classif.predicted_class;
	const float probability =
		p_model->decoded_output.classif.probabilities.p_f32[predicted_class];

	const bool detected = probability > confidence_threshold;

	/* Bit that will fall out of the rolling window. */
	const bool oldest_entry = (bool)(predictions_history & BIT(max_prediction_num_in_row));

	/* O(1) update of the count plus left-shift history. */
	prediction_count = prediction_count + detected - oldest_entry;
	predictions_history = (predictions_history << 1) | detected;

	if (prediction_count >= prediction_num_in_row) {
		/* Enough positive frames: fire once and clear state to avoid
		 * repeated triggers from stale history. */
		prediction_count = 0;
		predictions_history = 0;
		return true;
	}
	return false;
}
} // namespace

namespace Nrf
{
namespace AmbientSensing
{

const char *getModelName()
{
	return kLegacyModelName;
}

bool process(nrf_edgeai_t *p_model)
{
	static uint32_t prediction_count;
	static uint32_t predictions_history;

	return rolling_detector_step(p_model, kLegacyConfidenceThreshold,
				     kLegacyPredictionNumInRow, kDefaultMaxPredictionInRow,
				     prediction_count, predictions_history);
}

bool process(const ModelConfig &cfg, ModelRuntimeState &state, nrf_edgeai_t *p_model)
{
	return rolling_detector_step(p_model, cfg.confidence_threshold,
				     cfg.prediction_num_in_row, cfg.max_prediction_num_in_row,
				     state.prediction_count, state.predictions_history);
}

#ifdef CONFIG_AMBIENT_SENSING_MODEL_ALL
const ModelConfig kAllModels[] = {
	{
		.get_model = nrf_edgeai_user_model_snoring,
		.name = "Snoring",
		.confidence_threshold = 0.9f,
		.prediction_num_in_row = 20,
		.max_prediction_num_in_row = kDefaultMaxPredictionInRow,
	},
	{
		.get_model = nrf_edgeai_user_model_baby_crying,
		.name = "Baby Crying",
		.confidence_threshold = 0.996078f,
		.prediction_num_in_row = 3,
		.max_prediction_num_in_row = kDefaultMaxPredictionInRow,
	},
	{
		.get_model = nrf_edgeai_user_model_dog_barking,
		.name = "Dog Barking",
		.confidence_threshold = 0.9f,
		.prediction_num_in_row = 10,
		.max_prediction_num_in_row = kDefaultMaxPredictionInRow,
	},
	{
		.get_model = nrf_edgeai_user_model_cat_meowing,
		.name = "Cat Meowing",
		.confidence_threshold = 0.95f,
		.prediction_num_in_row = 9,
		.max_prediction_num_in_row = kDefaultMaxPredictionInRow,
	},
};
const size_t kAllModelsCount = ARRAY_SIZE(kAllModels);
#endif /* CONFIG_AMBIENT_SENSING_MODEL_ALL */

} // namespace AmbientSensing
} // namespace Nrf
```

## src/ambient_sensing.h
```c
/*
 * Copyright (c) 2026 Nordic Semiconductor ASA
 *
 * SPDX-License-Identifier: LicenseRef-Nordic-5-Clause
 */

#pragma once

#include <stddef.h>
#include <stdint.h>

#include <nrf_edgeai/nrf_edgeai.h>

namespace Nrf
{
namespace AmbientSensing
{

/**
 * @brief Legacy single-model post-processing (compile-time selected model).
 *
 * Uses internal static state; safe to call from a single thread only.
 */
bool process(nrf_edgeai_t *p_model);

/**
 * @brief Name of the compile-time selected model (legacy path).
 */
const char *getModelName();

/**
 * @brief Post-processing configuration for a single ambient sensing model.
 */
struct ModelConfig {
	/** Function returning the per-model @ref nrf_edgeai_t instance. */
	nrf_edgeai_t *(*get_model)(void);

	/** Human readable model name, used for logging. */
	const char *name;

	/** Confidence threshold above which the current frame is counted as a
	 * detection. */
	float confidence_threshold;

	/** Minimum number of positive detections accumulated within the
	 * history window to report a detection event. */
	uint32_t prediction_num_in_row;

	/** Size of the rolling history window in frames (bit-width used in
	 * the @ref predictions_history mask). */
	uint32_t max_prediction_num_in_row;
};

/**
 * @brief Per-thread rolling detector state.
 */
struct ModelRuntimeState {
	uint32_t prediction_count;
	uint32_t predictions_history;
};

/**
 * @brief Re-entrant post-processing used by multi-threaded mode.
 *
 * @return true when the rolling detector decides an event should be emitted.
 */
bool process(const ModelConfig &cfg, ModelRuntimeState &state, nrf_edgeai_t *p_model);

#ifdef CONFIG_AMBIENT_SENSING_MODEL_ALL
/**
 * @brief Compile-time upper bound on the number of models in @ref kAllModels.
 *        Used by consumers that need to size stack-allocated arrays.
 */
constexpr size_t kMaxAllModels = 8;

/**
 * @brief Table of all built-in ambient sensing models used when
 *        @c CONFIG_AMBIENT_SENSING_MODEL_ALL is enabled.
 */
extern const ModelConfig kAllModels[];
extern const size_t kAllModelsCount;
#endif

} // namespace AmbientSensing
} // namespace Nrf
```

## src/nrf_edgeai_task.cpp
```c
/*
 * Copyright (c) 2026 Nordic Semiconductor ASA
 *
 * SPDX-License-Identifier: LicenseRef-Nordic-5-Clause
 */

#include <errno.h>

#include <zephyr/audio/dmic.h>
#include <zephyr/device.h>
#include <zephyr/devicetree.h>
#include <zephyr/kernel.h>

#include "board/board.h"
#include "app/task_executor.h"
#include "dimming_effect.h"

#include "dmic.h"
#include "nrf_edgeai_task.h"
#include "app_task.h"
#include "ambient_sensing.h"
#include "models/all_models.h"

#include <app-common/zap-generated/attributes/Accessors.h>
#include <app-common/zap-generated/cluster-objects.h>
#include <app-common/zap-generated/ids/Clusters.h>
#include <app/EventLogging.h>
#include <platform/CHIPDeviceLayer.h>

#include <zephyr/logging/log.h>

LOG_MODULE_DECLARE(app, CONFIG_CHIP_APP_LOG_LEVEL);

using namespace ::chip;
using namespace ::chip::app;
using namespace ::chip::app::Clusters;
using namespace ::chip::DeviceLayer;

namespace
{
const struct device *const dmic_dev = DEVICE_DT_GET(DT_NODELABEL(dmic_dev));

#ifdef CONFIG_USE_OCCUPANCY_SENSOR_INSTEAD_OF_AMBIENT_SENSING
void ApplyOccupancyValue(EndpointId endpointId, uint8_t newOccupancyValue)
{
	using chip::BitMask;
	using chip::Protocols::InteractionModel::Status;

	BitMask<Clusters::OccupancySensing::OccupancyBitmap> currentOccupancy;
	Status status = Clusters::OccupancySensing::Attributes::Occupancy::Get(endpointId,
									       &currentOccupancy);

	if (status != Status::Success) {
		LOG_ERR("Occupancy::Get failed: %u", static_cast<unsigned>(to_underlying(status)));
		return;
	}

	if (static_cast<BitMask<Clusters::OccupancySensing::OccupancyBitmap>>(newOccupancyValue) ==
	    currentOccupancy) {
		return;
	}

	status = Clusters::OccupancySensing::Attributes::Occupancy::Set(endpointId,
									newOccupancyValue);
	if (status != Status::Success) {
		LOG_ERR("Occupancy::Set failed: %u", static_cast<unsigned>(to_underlying(status)));
		return;
	}

	if (newOccupancyValue == 1) {
		LOG_INF("Occupancy is now occupied");
	} else {
		LOG_INF("Occupancy is now vacant");
	}
}

void OccupancySensingChipWorkerHandler(intptr_t arg)
{
	ApplyOccupancyValue(CONFIG_AMBIENT_SENSING_ENDPOINT_ID, static_cast<uint8_t>(arg));
}

CHIP_ERROR RequestOccupancyMatterUpdate(uint8_t occupancyRaw)
{
	return DeviceLayer::PlatformMgr().ScheduleWork(OccupancySensingChipWorkerHandler,
						       static_cast<intptr_t>(occupancyRaw));
}
#endif

void ai_thread_fn()
{
	void *audio_buffer;
	size_t audio_buffer_size;
	const int32_t read_timeout = 100;
	int err = 0;

	LOG_INF("Starting Ambient Sensing Application...");
	LOG_INF("Model postprocessing adjustable parameters:");

	nrf_edgeai_rt_version_t libver = nrf_edgeai_runtime_version();
	LOG_INF("Nordic Edge AI Library version: %d.%d.%d", libver.field.major, libver.field.minor,
		libver.field.patch);

	nrf_edgeai_t *p_model = get_ambient_sensing_model();

	// Initialize ambient sensing model
	nrf_edgeai_err_t res = nrf_edgeai_init(p_model);
	if (res != NRF_EDGEAI_ERR_SUCCESS) {
		LOG_ERR("Failed to initialize Edge AI model %s, error code: %d",
			Nrf::AmbientSensing::getModelName(), res);
		return;
	}

	if (dmic_init()) {
		LOG_ERR("Failed to initialize DMIC");
		return;
	}

#if defined(CONFIG_PWM) && DT_HAS_ALIAS(pwm_led0) && DT_HAS_ALIAS(pwm_led1) &&                     \
	DT_HAS_ALIAS(pwm_led2) && DT_HAS_ALIAS(pwm_led3)
	{
		Nrf::DimmingEffect::Config dim_cfg;

		dim_cfg.effect_timeout_s = 5;
		dim_cfg.blink_pairs_multiplier = 3;
		(void)Nrf::DimmingEffect::Init(
			dim_cfg,
			[](void *) {
#ifdef CONFIG_USE_OCCUPANCY_SENSOR_INSTEAD_OF_AMBIENT_SENSING
				if (RequestOccupancyMatterUpdate(0) != CHIP_NO_ERROR) {
					LOG_ERR("Failed to schedule occupancy clear to Matter "
						"stack");
				}
#endif
			},
			nullptr);
	}
#endif

	LOG_INF("Edge AI initialization completed");

	if (dmic_trigger(dmic_dev, DMIC_TRIGGER_START) < 0) {
		LOG_ERR("Failed to start DMIC");
		return;
	}

	while (true) {
		err = dmic_read(dmic_dev, 0, &audio_buffer, &audio_buffer_size, read_timeout);
		if (err != 0) {
			/* No data yet or driver busy: avoid a tight loop and log spam. */
			if (err == -EAGAIN || err == -EBUSY) {
				k_yield();
				continue;
			}
			LOG_WRN("DMIC read failed (err %d)", err);
			k_sleep(K_MSEC(1));
			continue;
		}

		if (!EdgeAITask::Instance().IsEnabled()) {
			free_dmic_buffer(audio_buffer);
			continue;
		}

		size_t samples_num = audio_buffer_size / DMIC_SAMPLE_BYTES;

		// Feed audio data to the model dsp pipeline and
		// waiting for internal buffers to be filled with enough data for feature extraction
		res = nrf_edgeai_feed_inputs(p_model, audio_buffer, samples_num);
		free_dmic_buffer(audio_buffer);

		if (res != NRF_EDGEAI_ERR_SUCCESS) {
			continue;
		}

		// Run feature extraction and model inference
		res = nrf_edgeai_run_inference(p_model);

		if (res != NRF_EDGEAI_ERR_SUCCESS) {
			continue;
		}

		// Run postprocessing on the model output to determine if snoring is detected based
		// on the model inference results
		if (Nrf::AmbientSensing::process(p_model)) {
			LOG_INF("%s detected", Nrf::AmbientSensing::getModelName());
			Nrf::PostTask([] {
#if defined(CONFIG_PWM) && DT_HAS_ALIAS(pwm_led0) && DT_HAS_ALIAS(pwm_led1) &&                     \
	DT_HAS_ALIAS(pwm_led2) && DT_HAS_ALIAS(pwm_led3)
				Nrf::DimmingEffect::Start();
#endif
			});
#ifdef CONFIG_USE_OCCUPANCY_SENSOR_INSTEAD_OF_AMBIENT_SENSING
			if (RequestOccupancyMatterUpdate(1) != CHIP_NO_ERROR) {
				LOG_ERR("Failed to schedule occupancy update to Matter stack");
			}
#endif
		}
	}
}

K_THREAD_DEFINE(ai_thread_id, CONFIG_AI_THREAD_STACK_SIZE, ai_thread_fn, NULL, NULL, NULL,
		CONFIG_AI_THREAD_PRIORITY, K_FP_REGS, SYS_FOREVER_MS);
} // namespace

CHIP_ERROR EdgeAITask::Start()
{
	k_thread_start(ai_thread_id);
	return CHIP_NO_ERROR;
}

void EdgeAITask::Enable()
{
	LOG_INF("\n\nWaiting for %s source...\n\n", Nrf::AmbientSensing::getModelName());
	enabled.store(true, std::memory_order_release);
}

void EdgeAITask::Disable()
{
	enabled.store(false, std::memory_order_release);
	LOG_INF("\n\nEdge AI listening disabled\n\n");
}

void MatterPostAttributeChangeCallback(const chip::app::ConcreteAttributePath &attributePath,
				       uint8_t type, uint16_t size, uint8_t *value)
{
	ClusterId clusterId = attributePath.mClusterId;
	AttributeId attributeId = attributePath.mAttributeId;

#ifdef CONFIG_USE_OCCUPANCY_SENSOR_INSTEAD_OF_AMBIENT_SENSING
	if (clusterId == OccupancySensing::Id &&
	    attributeId == OccupancySensing::Attributes::Occupancy::Id) {
	}
#endif
}

void MatterAmbientContextSensingPluginServerInitCallback()
{
	// For now nothing
}
```
